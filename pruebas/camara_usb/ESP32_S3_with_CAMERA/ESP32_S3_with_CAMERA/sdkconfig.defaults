## pruebas/camara_usb/ESP32_S3_with_CAMERA/ESP32_S3_with_CAMERA/sdkconfig.defaults
```kconfig
CONFIG_SPIRAM=y
CONFIG_SPIRAM_MALLOC_RESERVE_INTERNAL=150000
CONFIG_USB_HOST_CONTROL_TRANSFER_MAX_SIZE=3000
CONFIG_USB_HOST_HW_BUFFER_BIAS_IN=y
CONFIG_SPIRAM_IGNORE_NOTFOUND=y
CONFIG_ESP_CONSOLE_SECONDARY_NONE=y
# CONFIG_USJ_ENABLE_USB_SERIAL_JTAG is not set
```

## pruebas/camara_usb/ESP32_S3_with_CAMERA/ESP32_S3_with_CAMERA/sdkconfig.defaults.esp32s3
```kconfig
CONFIG_SPIRAM_SPEED_80M=y
CONFIG_ESP_DEFAULT_CPU_FREQ_MHZ_240=y
CONFIG_ESPTOOLPY_FLASHSIZE_16MB=y
```
